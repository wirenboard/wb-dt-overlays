/dts-v1/;
/plugin/;

/ {
    description = "Enable eth1 on WB6";
    compatible = "contactless,imx6ul-wirenboard61";

    fragment@0 {
        target = <&fec2>;
        __overlay__ {
            status = "okay";
        };
    };
};
