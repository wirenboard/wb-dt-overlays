/*
 * Common parameters for Bluetooth module
 */

/ {
    fragment-bt-status {
        target-path = "/wirenboard";

        __overlay__ {
            bluetooth {
                status = "okay";
            };
        };
    };
};
