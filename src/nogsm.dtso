/dts-v1/;
/plugin/;

/*
 * Dummy overlay which leaves GSM turned off and
 * tells about it in /wirenboard section
 */

/ {
    fragment-nogsm {
        target-path = "/wirenboard";

        __overlay__ {
            gsm {
                status = "disabled";
                model = "none";
            };
        };
    };
};
