/dts-v1/;
/plugin/;

#include "noradio.dtsi"

/ {
    description = "Disable radio module on WB5";
    compatible = "contactless,imx28-wirenboard58,imx28-wirenboard56,imx28-wirenboard52,imx28-wirenboard50";

    fragment-wb5-noradio {
        target = <&ssp1gpio>;
        
        __overlay__ {
            status = "disabled";
        };
    };
};
