/dts-v1/;
/plugin/;

/*
 * Dummy overlay which leaves radio module turned off and
 * tells about it in /wirenboard section
 */

/ {
    fragment@0 {
        target-path = "/wirenboard";

        __overlay__ {
            rfm {
                status = "disabled";
                model = "none";
            };
        };
    };
};
