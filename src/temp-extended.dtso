/dts-v1/;
/plugin/;

/ {
    fragment-temp-extended {
        target-path = "/wirenboard";

        __overlay__ {
            temperature {
                grade = "extended";
                min = "-20";
                max = "80";
            };
        };
    };
};
