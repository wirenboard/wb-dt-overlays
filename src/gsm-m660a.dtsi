/*
 * Common parameters for Neoway M660A GSM modems
 */

/ {
    fragment-gsm-m660a-description {
        target-path = "/wirenboard";

        __overlay__ {
            gsm {
                model = "m660a";
                type = "gprs";
            };
        };
    };
};
