/dts-v1/;
/plugin/;

/*
 * Dummy overlay which leaves radio module turned off and
 * tells about it in /wirenboard section
 */

/ {
    fragment-noradio {
        target-path = "/wirenboard";

        __overlay__ {
            radio {
                status = "disabled";
                model = "none";
            };
        };
    };
};
