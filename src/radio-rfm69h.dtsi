/*
 * Common parameters for RFM69H modules
 */

/ {
    fragment-radio-rfm69h-description {
        target-path = "/wirenboard";

        __overlay__ {
            radio {
                model = "rfm69h";
                frequencies-mhz = <433>;
            };
        };
    };
};
