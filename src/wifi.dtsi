/*
 * Common parameters for Wi-Fi module
 */

/ {
    fragment-wifi-status {
        target-path = "/wirenboard";

        __overlay__ {
            wifi {
                status = "okay";
            };
        };
    };
};
