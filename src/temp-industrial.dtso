/dts-v1/;
/plugin/;

/ {
    fragment-temp-industrial {
        target-path = "/wirenboard";

        __overlay__ {
            temperature {
                grade = "industrial";
                min = "-40";
                max = "85";
            };
        };
    };
};
