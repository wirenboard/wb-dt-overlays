/dts-v1/;
/plugin/;

/*
 * Dummy overlay which leaves Wi-Fi turned off and
 * tells about it in /wirenboard section
 */

/ {
    fragment-nowifi {
        target-path = "/wirenboard";

        __overlay__ {
            wifi {
                status = "disabled";
                model = "none";
            };
        };
    };
};
