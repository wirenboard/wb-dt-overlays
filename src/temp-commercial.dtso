/dts-v1/;
/plugin/;

/ {
    fragment-temp-commercial {
        target-path = "/wirenboard";

        __overlay__ {
            temperature {
                grade = "commercial";
                min = "0";
                max = "70";
            };
        };
    };
};
