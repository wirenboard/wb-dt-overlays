/*
 * Standard definitions for all GSM overlays for WB5
 */

/ {
    compatible = "contactless,imx28-wirenboard58","contactless,imx28-wirenboard55", "contactless,imx28-wirenboard52", "contactless,imx28-wirenboard50", "fsl,imx28";

    /* Enable UART for GSM module */
    fragment-gsm-wb5-uart {
        target = <&auart0>;

        __overlay__ {
            status = "okay";
        };
    };

    fragment-gsm-wb5-status {
        target-path = "/wirenboard";

        __overlay__ {
            gsm {
                status = "okay";
            };
        };
    };
};
