/*
 * Common parameters for SIM5300e GSM modems
 */

/ {
    fragment-gsm-sim5300e-description {
        target-path = "/wirenboard";

        __overlay__ {
            gsm {
                model = "sim5300e";
                type = "3g", "edge", "gprs";
            };
        };
    };
};
