/*
 * Standard definitions for all GSM overlays for WB6
 */

/ {
    compatible = "contactless,imx6ul-wirenboard61", "contactless,imx6ul-wirenboard60", "contactless,imx6ul-wirenboard-evk", "fsl,imx6ul-14x14-evk", "fsl,imx6ul";

    /* Enable UART for GSM module */
    fragment-wb6-gsm-uart {
        target = <&uart6>;

        __overlay__ {
            status = "okay";
        };
    };

    fragment-wb6-gsm-status {
        target-path = "/wirenboard";

        __overlay__ {
            gsm {
                status = "okay";
            };
        };
    };
};
