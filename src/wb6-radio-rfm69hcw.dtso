/dts-v1/;
/plugin/;

/*
 * Standard definitions for RFM69HCW for WB6
 */

#include "wb6-radio-rfm69.dtsi"

/ {
    fragment-radio-rfm69hcw-description {
        target-path = "/wirenboard";

        __overlay__ {
            radio {
                model = "rfm69hcw";
                frequencies-mhz = <433>;
            };
        };
    };
};
