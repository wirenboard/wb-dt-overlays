/dts-v1/;
/plugin/;

#include "nogsm.dtsi"

/ {
    description = "Disable GSM on WB6";
    compatible = "contactless,imx6ul-wirenboard61";

    fragment-wb6-nogsm {
        target = <&uart6>;

        __overlay__ {
            status = "disabled";
        };
    };
};
