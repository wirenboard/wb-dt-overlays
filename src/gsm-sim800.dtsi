/*
 * Common parameters for SIM800 GSM modems
 */

/ {
    fragment-gsm-sim800-description {
        target-path = "/wirenboard";

        __overlay__ {
            gsm {
                model = "sim800";
                type = "edge", "gprs";
            };
        };
    };
};
