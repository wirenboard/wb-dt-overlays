/dts-v1/;
/plugin/;

/*
 * Dummy overlay which leaves Bluetooth turned off and
 * tells about it in /wirenboard section
 */

/ {
    fragment-nobt {
        target-path = "/wirenboard";

        __overlay__ {
            bluetooth {
                status = "disabled";
                model = "none";
            };
        };
    };
};
